#include <stdio.h>
#include <string.h>

#include "driver/gpio.h"
#include "driver/i2c_master.h"
#include "esp_log.h"
#include "esp_task.h"
#include "math.h"
#include "sdkconfig.h"

#define I2C_MASTER_SCL_IO GPIO_NUM_22  // GPIO pin
#define I2C_MASTER_SDA_IO GPIO_NUM_21  // GPIO pin
#define I2C_MASTER_FREQ_HZ 10000
#define ESP_SLAVE_ADDR 0x68
#define WRITE_BIT 0x0
#define READ_BIT 0x1
#define ACK_CHECK_EN 0x0
#define EXAMPLE_I2C_ACK_CHECK_DIS 0x0
#define ACK_VAL 0x0
#define NACK_VAL 0x1
#define Fodr 800
#define UART_NUM

esp_err_t ret = ESP_OK;
esp_err_t ret2 = ESP_OK;

_CRTIMP __cdecl __MINGW_NOTHROW  int atoi (const char *);

uint16_t val0[6];

/*! @name  Global array that stores the configuration file of BMI270 */
const uint8_t bmi270_config_file[] = {
    0xc8, 0x2e, 0x00, 0x2e, 0x80, 0x2e, 0x3d, 0xb1, 0xc8, 0x2e, 0x00, 0x2e, 0x80, 0x2e, 0x91, 0x03, 0x80, 0x2e, 0xbc,
    0xb0, 0x80, 0x2e, 0xa3, 0x03, 0xc8, 0x2e, 0x00, 0x2e, 0x80, 0x2e, 0x00, 0xb0, 0x50, 0x30, 0x21, 0x2e, 0x59, 0xf5,
    0x10, 0x30, 0x21, 0x2e, 0x6a, 0xf5, 0x80, 0x2e, 0x3b, 0x03, 0x00, 0x00, 0x00, 0x00, 0x08, 0x19, 0x01, 0x00, 0x22,
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    0x2e, 0x00, 0xc1};

i2c_master_dev_handle_t device;

esp_err_t bmi_read(uint8_t *data_address, uint8_t *data_rd, size_t size) {
    if (size == 0) {
        return ESP_OK;
    }
    esp_err_t ret;

    // Perform I2C read operation
    ret = i2c_master_transmit(device, data_address, 1, pdMS_TO_TICKS(1000));
    if (ret != ESP_OK) {
        return ret;
    }

    ret = i2c_master_receive(device, data_rd, size, pdMS_TO_TICKS(1000));
    return ret;
}

esp_err_t bmi_write(uint8_t *data_address, uint8_t *data_wr, size_t size) {
    esp_err_t ret;

    // Perform I2C write operation
    uint8_t full_data[1 + size];
    full_data[0] = *data_address;
    memcpy(&full_data[1], data_wr, size);

    ret = i2c_master_transmit(device, full_data, sizeof(full_data), pdMS_TO_TICKS(1000));
    return ret;
}

esp_err_t bmi_init() {
    esp_err_t ret;

    i2c_master_bus_config_t i2c_mst_config = {
        .clk_source = I2C_CLK_SRC_DEFAULT,
        .i2c_port = I2C_NUM_0,
        .scl_io_num = I2C_MASTER_SCL_IO,
        .sda_io_num = I2C_MASTER_SDA_IO,
        .glitch_ignore_cnt = 7,
        .flags.enable_internal_pullup = true,
    };

    i2c_master_bus_handle_t bus_handle;
    ESP_ERROR_CHECK(i2c_new_master_bus(&i2c_mst_config, &bus_handle));

    i2c_device_config_t dev_cfg = {
        .dev_addr_length = I2C_ADDR_BIT_LEN_7,
        .device_address = ESP_SLAVE_ADDR,
        .scl_speed_hz = 100000,
    };

    // Add I2C device
    ret = i2c_master_bus_add_device(bus_handle, &dev_cfg, &device);
    return ret;
}

void chipid(void) {
    uint8_t reg_id = 0x00;
    uint8_t tmp;

    bmi_read(&reg_id, &tmp, 1);
    printf("Valor de Chip ID: %2X \n\n", tmp);
    if (tmp == 0x24) {
        printf("Chip reconocido.\n\n");
    }
    if (tmp != 0x24) {
        printf("Chip no reconocido. \nChip ID: %2x (deberia ser 0x24)\n\n", tmp);  // %2X
        exit(EXIT_SUCCESS);
    }
}

void softreset(void) {
    uint8_t reg_softreset = 0x7E, val_softreset = 0xB6;

    ret = bmi_write(&reg_softreset, &val_softreset, 1);
    vTaskDelay(1000 / portTICK_PERIOD_MS);
    if (ret != ESP_OK) {
        printf("\nError en softreset: %s \n", esp_err_to_name(ret));
    } else {
        printf("\nSoftreset: OK\n\n");
    }
}

void powermode(void) {
    uint8_t reg_pwr_conf = 0x7C, reg_pwr_ctrl = 0x7D;
    uint8_t tmp, tmp2;

    ret = bmi_read(&reg_pwr_conf, &tmp, 1);
    printf("Valor de PWR_CONF: %2X \n", tmp);
    if (ret != ESP_OK) {
        printf("Error en PWR_CONF: %s \n", esp_err_to_name(ret));
    }

    ret2 = bmi_read(&reg_pwr_ctrl, &tmp2, 1);
    printf("Valor de PWR_CTRL: %2X \n", tmp2);
    if (ret2 != ESP_OK) {
        printf("Error en PWR_CTRL: %s \n", esp_err_to_name(ret2));
    }
}

void initialization(void) {
    uint8_t reg_pwr_conf_advpowersave = 0x7C, val_pwr_conf_advpowersave = 0x00;
    uint8_t reg_init_ctrl = 0x59, val_init_ctrl = 0x00, val_init_ctrl2 = 0x01;
    uint8_t reg_init_data = 0x5E;  //, tmp;

    printf("Inicializando ...\n");

    bmi_write(&reg_pwr_conf_advpowersave, &val_pwr_conf_advpowersave, 1);

    vTaskDelay(1000 / portTICK_PERIOD_MS);

    ret = bmi_write(&reg_init_ctrl, &val_init_ctrl, 1);

    int config_size = sizeof(bmi270_config_file);
    // printf("Tamano config_file: %d\n\n",config_size);

    ret = bmi_write(&reg_init_data, (uint8_t *)bmi270_config_file, config_size);
    if (ret != ESP_OK) {
        printf("\nError cargando config_file\n");
    } else {
        printf("\nConfig_file cargado.\n");
    }

    vTaskDelay(1000 / portTICK_PERIOD_MS);

    ret = bmi_write(&reg_init_ctrl, &val_init_ctrl2, 1);
    // if(ret != ESP_OK){
    //     printf("Error en write4: %s \n",esp_err_to_name(ret));
    // }
    // else {
    //      printf("Init_ctrl = 1\n");
    // }

    printf("\nAlgoritmo de inicializacion finalizado.\n\n");

    // vTaskDelay(1000 /portTICK_PERIOD_MS);
}

void check_initialization(void) {
    uint8_t reg_internalstatus = 0x21;
    uint8_t tmp;

    vTaskDelay(1000 / portTICK_PERIOD_MS);

    bmi_read(&reg_internalstatus, &tmp, 1);
    printf("Init_status.0: %x \n", (tmp & 0b00001111));
    if ((tmp & 0b00001111) == 1) {
        printf("Comprobacion Inicializacion: OK\n\n");
    } else {
        printf("Inicializacion fallida\n\n");
        exit(EXIT_SUCCESS);
    }
}

// Setea la ventana en la nvs
void set_window_nvs(int ventana) {
    ventana = (int32_t)ventana;
    // Initialize NVS
    esp_err_t err = nvs_flash_init();
    if (err == ESP_ERR_NVS_NO_FREE_PAGES || err == ESP_ERR_NVS_NEW_VERSION_FOUND) {
        // NVS partition was truncated and needs to be erased
        // Retry nvs_flash_init
        ESP_ERROR_CHECK(nvs_flash_erase());
        err = nvs_flash_init();
    }
    ESP_ERROR_CHECK( err );

    // Open
    printf("\n");
    printf("Opening Non-Volatile Storage (NVS) handle... ");
    nvs_handle_t my_handle;
    err = nvs_open("storage", NVS_READWRITE, &my_handle);
    if (err != ESP_OK) {
        printf("Error (%s) opening NVS handle!\n", esp_err_to_name(err));
    } else {
        printf("Done\n");

        // Read
        printf("Reading window from NVS ... ");
        int32_t window = 20; // value will default to 20, if not set yet in NVS
        err = nvs_get_i32(my_handle, "window", &window);
        switch (err) {
            case ESP_OK:
                printf("Done\n");
                printf("window = %" PRIu32 "\n", window);
                break;
            case ESP_ERR_NVS_NOT_FOUND:
                printf("The value is not initialized yet!\n");
                break;
            default :
                printf("Error (%s) reading!\n", esp_err_to_name(err));
        }

        // Write
        printf("Updating restart counter in NVS ... ");
        window = ventana;
        err = nvs_set_i32(my_handle, "window", window);
        printf((err != ESP_OK) ? "Failed!\n" : "Done\n");

        // Commit written value.
        // After setting any values, nvs_commit() must be called to ensure changes are written
        // to flash storage. Implementations may write to storage at other times,
        // but this is not guaranteed.
        printf("Committing updates in NVS ... ");
        err = nvs_commit(my_handle);
        printf((err != ESP_OK) ? "Failed!\n" : "Done\n");

        // Close
        nvs_close(my_handle);
    }
}

// Obtine el valor de la ventana en la nvs. Si no existe aún, retorna 20 y lo setea en 20
int get_window_nvs(void){
    // Initialize NVS
    esp_err_t err = nvs_flash_init();
    if (err == ESP_ERR_NVS_NO_FREE_PAGES || err == ESP_ERR_NVS_NEW_VERSION_FOUND) {
        // NVS partition was truncated and needs to be erased
        // Retry nvs_flash_init
        ESP_ERROR_CHECK(nvs_flash_erase());
        err = nvs_flash_init();
    }
    ESP_ERROR_CHECK( err );

    // Open
    printf("\n");
    printf("Opening Non-Volatile Storage (NVS) handle... ");
    nvs_handle_t my_handle;
    err = nvs_open("storage", NVS_READWRITE, &my_handle);
    if (err != ESP_OK) {
        printf("Error (%s) opening NVS handle!\n", esp_err_to_name(err));
        return -1;
    } else {
        printf("Done\n");

        // Read
        printf("Reading window from NVS ... ");
        int32_t window = 20; // value will default to 20, if not set yet in NVS
        err = nvs_get_i32(my_handle, "window", &window);
        switch (err) {
            case ESP_OK:
                printf("Done\n");
                printf("window = %" PRIu32 "\n", window);
                break;
            case ESP_ERR_NVS_NOT_FOUND:
                printf("The value is not initialized yet!\n");
                break;
            default :
                printf("Error (%s) reading!\n", esp_err_to_name(err));
        }

        // Close
        nvs_close(my_handle);
        return window;
    }
}

// Calcula la RMS de un array de floats
float calc_RMS(float *arr, int ventana){
    float raiz = 0;
    float sum = 0;

    for(int i = 0; i < ventana; i++){
        sum += arr[i] * arr[i];
    }

    raiz = sqrt(sum/(float)ventana);
    return raiz;
}

// reinicia la ESP y termina la conexión
void restart_ESP(){
    // Reiniciar la ESP y terminar conexión
    for (int i = 10; i >= 0; i--) {
        printf("Restarting in %d seconds...\n", i);
        vTaskDelay(1000 / portTICK_PERIOD_MS);
    }
    printf("Restarting now.\n");
    fflush(stdout);
    esp_restart();
}

/**
 * @brief Funcion que calcula la FFT de un arreglo y guarda el resultado inplace
 *
 * @param array Arreglo de elementos sobre los que se quiere calcular la FFT
 * @param size Tamano del arreglo
 * @param array_re Direccion del arreglo donde se guardara la parte real. Debe ser de tamano size
 * @param array_im Direccion del arreglo donde se guardara la parte imaginaria. Debe ser de tamano size
 */
void calcularFFT(float *array, int size, float *array_re, float *array_im) {
    for (int k = 0; k < size; k++) {
        float real = 0;
        float imag = 0;

        for (int n = 0; n < size; n++) {
            float angulo = 2 * M_PI * k * n / size;
            float cos_angulo = cos(angulo);
            float sin_angulo = -sin(angulo);

            real += array[n] * cos_angulo;
            imag += array[n] * sin_angulo;
        }
        real /= size;
        imag /= size;
        array_re[k] = real;
        array_im[k] = imag;
    }
}

void modulo(float *real, float *imag, float *mod, int size) {
    for (int i = 0; i < size; i++) {
        mod[i] = sqrt(real[i] * real[i] + imag[i] * imag[i]);
    }
}

// Función de comparación para ordenar de mayor a menor
int comparar(const void *a, const void *b) {
    return (*(int*)b - *(int*)a);  // Cambiar el orden de comparación
}

void internal_status(void) {
    uint8_t reg_internalstatus = 0x21;
    uint8_t tmp;

    bmi_read(&reg_internalstatus, &tmp, 1);
    // printf("Initial status: %x \n",(tmp & 0b00001111));
    printf("Internal Status: %2X\n\n", tmp);
}

void lectura(int window, int time) {
    uint8_t reg_intstatus = 0x03, tmp;
    uint8_t addr_acc_z_lsb = 0x10;
    uint8_t addr_acc_z_msb = 0x11;
    uint8_t addr_acc_y_lsb = 0x0E;
    uint8_t addr_acc_y_msb = 0x0F;
    uint8_t addr_acc_x_lsb = 0x0C;
    uint8_t addr_acc_x_msb = 0x0D;

    uint8_t addr_gyr_z_lsb = 0x16;
    uint8_t addr_gyr_z_msb = 0x17;
    uint8_t addr_gyr_y_lsb = 0x14;
    uint8_t addr_gyr_y_msb = 0x15;
    uint8_t addr_gyr_x_lsb = 0x12;
    uint8_t addr_gyr_x_msb = 0x13;

    uint16_t acc_z;
    uint16_t acc_y;
    uint16_t acc_x;

    uint16_t gyr_z;
    uint16_t gyr_y;
    uint16_t gyr_x;

    float data_acc_z[window];
    float data_acc_y[window];
    float data_acc_x[window];

    float data_gyr_z[window];
    float data_gyr_y[window];
    float data_gyr_x[window];

    float rms_acc_x = 0;
    float rms_acc_y = 0;
    float rms_acc_z = 0;
    float rms_gyr_x = 0;
    float rms_gyr_y = 0;
    float rms_gyr_z = 0;
    for (int i = 0; i < window; i++){
        bmi_read(&reg_intstatus, &tmp, 1);
        if ((tmp & 0b10000000) == 0x80) {
            // Leyendo datos de acelerómetro
            ret = bmi_read(&addr_acc_x_msb, &tmp, 1);
            acc_x = tmp;
            ret = bmi_read(&addr_acc_x_lsb, &tmp, 1);
            acc_x = (acc_z << 8) | tmp;
            data_acc_x[i] = acc_x;
            ret = bmi_read(&addr_acc_y_msb, &tmp, 1);
            acc_y = tmp;
            ret = bmi_read(&addr_acc_y_lsb, &tmp, 1);
            acc_y = (acc_z << 8) | tmp;
            data_acc_y[i] = acc_y;
            ret = bmi_read(&addr_acc_z_msb, &tmp, 1);
            acc_z = tmp;
            ret = bmi_read(&addr_acc_z_lsb, &tmp, 1);
            acc_z = (acc_z << 8) | tmp;
            data_acc_z[i] = acc_z; 

            // Leyendo datos de giroscopio
            ret = bmi_read(&addr_gyr_x_msb, &tmp, 1);
            gyr_x = tmp;
            ret = bmi_read(&addr_gyr_x_lsb, &tmp, 1);
            gyr_x = (acc_z << 8) | tmp;
            data_gyr_x[i] = gyr_x;
            ret = bmi_read(&addr_gyr_y_msb, &tmp, 1);
            gyr_y = tmp;
            ret = bmi_read(&addr_gyr_y_lsb, &tmp, 1);
            gyr_y = (acc_z << 8) | tmp;
            data_gyr_y[i] = gyr_y;
            ret = bmi_read(&addr_gyr_z_msb, &tmp, 1);
            gyr_z = tmp;
            ret = bmi_read(&addr_gyr_z_lsb, &tmp, 1);
            gyr_z = (acc_z << 8) | tmp;
            data_gyr_z[i] = gyr_z;

            //Calculamos el RMS de los datos
            //printf("Calculando RMS de los datos\n");
            rms_acc_x += (acc_x * acc_x) / window;
            rms_acc_y += (acc_y * acc_y) / window;
            rms_acc_z += (acc_z * acc_z) / window;
            rms_gyr_x += (gyr_x * gyr_x) / window;
            rms_gyr_y += (gyr_y * gyr_y) / window;
            rms_gyr_z += (gyr_z * gyr_z) / window;
    
            printf("acc_z: %f g\n", (int16_t)acc_z * (8.000 / 32768));
            
            uart_write_bytes(UART_NUM, acc_z, strlen(acc_z));
            uart_write_bytes(UART_NUM, " ", 1);
            uart_write_bytes(UART_NUM, acc_y, strlen(acc_y));
            uart_write_bytes(UART_NUM, " ", 1);
            uart_write_bytes(UART_NUM, acc_x, strlen(acc_x));
            uart_write_bytes(UART_NUM, " ", 1);

            uart_write_bytes(UART_NUM, gyr_z, strlen(gyr_z));
            uart_write_bytes(UART_NUM, " ", 1);
            uart_write_bytes(UART_NUM, gyr_y, strlen(gyr_y));
            uart_write_bytes(UART_NUM, " ", 1);
            uart_write_bytes(UART_NUM, gyr_x, strlen(gyr_x));
            uart_write_bytes(UART_NUM, " ", 1);

            if (ret != ESP_OK) {
                printf("Error lectura: %s \n", esp_err_to_name(ret));
            }
        }
    }
    // Calculamos el RMS de los datos
    printf("Calculando RMS de los datos\n");
    float final_rms_acc_x = sqrt(rms_acc_x);
    float final_rms_acc_y = sqrt(rms_acc_y);
    float final_rms_acc_z = sqrt(rms_acc_z);
    float final_rms_gyr_x = sqrt(rms_gyr_x);
    float final_rms_gyr_y = sqrt(rms_gyr_y);
    float final_rms_gyr_z = sqrt(rms_gyr_z);

    // Calculamos la FFT de los datos
    float fft_acc_x_real[window], fft_acc_x_imag[window];
    float fft_acc_y_real[window], fft_acc_y_imag[window];
    float fft_acc_z_real[window], fft_acc_z_imag[window];
    float fft_gyr_x_real[window], fft_gyr_x_imag[window];
    float fft_gyr_y_real[window], fft_gyr_y_imag[window];
    float fft_gyr_z_real[window], fft_gyr_z_imag[window];

    calcularFFT(data_acc_x, window, fft_acc_x_real, fft_acc_x_imag);
    calcularFFT(data_acc_y, window, fft_acc_y_real, fft_acc_y_imag);
    calcularFFT(data_acc_z, window, fft_acc_z_real, fft_acc_z_imag);
    calcularFFT(data_gyr_x, window, fft_gyr_x_real, fft_gyr_x_imag);
    calcularFFT(data_gyr_y, window, fft_gyr_y_real, fft_gyr_y_imag);
    calcularFFT(data_gyr_z, window, fft_gyr_z_real, fft_gyr_z_imag);
    
    // Calculo de los 5 peaks
    printf("Calculando los 5 peaks de los datos\n");
    qsort(data_acc_x, window, sizeof(float), comparar);
    qsort(data_acc_y, window, sizeof(float), comparar);
    qsort(data_acc_z, window, sizeof(float), comparar);
    qsort(data_gyr_x, window, sizeof(float), comparar);
    qsort(data_gyr_y, window, sizeof(float), comparar);
    qsort(data_gyr_z, window, sizeof(float), comparar);

    // Enviamos los datos de RMS
    printf("Enviando RMS de los datos\n");
    char send_acc_x_rms[20];
    char send_acc_y_rms[20];
    char send_acc_z_rms[20];
    char send_gyr_x_rms[20];
    char send_gyr_y_rms[20];
    char send_gyr_z_rms[20];
    
    sprintf(send_acc_x_rms, "%f", final_rms_acc_x);
    sprintf(send_acc_y_rms, "%f", final_rms_acc_y);
    sprintf(send_acc_z_rms, "%f", final_rms_acc_z);
    sprintf(send_gyr_x_rms, "%f", final_rms_gyr_x);
    sprintf(send_gyr_y_rms, "%f", final_rms_gyr_y);
    sprintf(send_gyr_z_rms, "%f", final_rms_gyr_z);
    uart_write_bytes(UART_NUM, send_acc_x_rms, strlen(send_acc_x_rms));
    uart_write_bytes(UART_NUM, " ", 1);
    uart_write_bytes(UART_NUM, send_acc_y_rms, strlen(send_acc_y_rms));
    uart_write_bytes(UART_NUM, " ", 1);
    uart_write_bytes(UART_NUM, send_acc_z_rms, strlen(send_acc_z_rms));
    uart_write_bytes(UART_NUM, " ", 1);
    uart_write_bytes(UART_NUM, send_gyr_x_rms, strlen(send_gyr_x_rms));
    uart_write_bytes(UART_NUM, " ", 1);
    uart_write_bytes(UART_NUM, send_gyr_y_rms, strlen(send_gyr_y_rms));
    uart_write_bytes(UART_NUM, " ", 1);
    uart_write_bytes(UART_NUM, send_gyr_z_rms, strlen(send_gyr_z_rms));
    uart_write_bytes(UART_NUM, " ", 1);


    vTaskDelay(pdMS_TO_TICKS(time+2000));

    printf("Enviando FFT de los datos\n");
    vTaskDelay(pdMS_TO_TICKS(time));
    for (int i=0; i<window; i++){

        vTaskDelay(pdMS_TO_TICKS(time));

        char send_acc_x_fft_real[20], send_acc_x_fft_imag[20];
        char send_acc_y_fft_real[20], send_acc_y_fft_imag[20];
        char send_acc_z_fft_real[20], send_acc_z_fft_imag[20];
        char send_gyr_x_fft_real[20], send_gyr_x_fft_imag[20];
        char send_gyr_y_fft_real[20], send_gyr_y_fft_imag[20];
        char send_gyr_z_fft_real[20], send_gyr_z_fft_imag[20];
        sprintf(send_acc_x_fft_real, "%f", fft_acc_x_real[i]);
        sprintf(send_acc_x_fft_imag, "%f", fft_acc_x_imag[i]);
        sprintf(send_acc_y_fft_real, "%f", fft_acc_y_real[i]);
        sprintf(send_acc_y_fft_imag, "%f", fft_acc_y_imag[i]);
        sprintf(send_acc_z_fft_real, "%f", fft_acc_z_real[i]);
        sprintf(send_acc_z_fft_imag, "%f", fft_acc_z_imag[i]);
        sprintf(send_gyr_x_fft_real, "%f", fft_gyr_x_real[i]);
        sprintf(send_gyr_x_fft_imag, "%f", fft_gyr_x_imag[i]);
        sprintf(send_gyr_y_fft_real, "%f", fft_gyr_y_real[i]);
        sprintf(send_gyr_y_fft_imag, "%f", fft_gyr_y_imag[i]);
        sprintf(send_gyr_z_fft_real, "%f", fft_gyr_z_real[i]);
        sprintf(send_gyr_z_fft_imag, "%f", fft_gyr_z_imag[i]);

        uart_write_bytes(UART_NUM, send_acc_x_fft_real, strlen(send_acc_x_fft_real));
        uart_write_bytes(UART_NUM, " ", 1);
        uart_write_bytes(UART_NUM, send_acc_x_fft_imag, strlen(send_acc_x_fft_imag));
        uart_write_bytes(UART_NUM, " ", 1);
        uart_write_bytes(UART_NUM, send_acc_y_fft_real, strlen(send_acc_y_fft_real));
        uart_write_bytes(UART_NUM, " ", 1);
        uart_write_bytes(UART_NUM, send_acc_y_fft_imag, strlen(send_acc_y_fft_imag));
        uart_write_bytes(UART_NUM, " ", 1);
        uart_write_bytes(UART_NUM, send_acc_z_fft_real, strlen(send_acc_z_fft_real));
        uart_write_bytes(UART_NUM, " ", 1);
        uart_write_bytes(UART_NUM, send_acc_z_fft_imag, strlen(send_acc_z_fft_imag));
        uart_write_bytes(UART_NUM, " ", 1);
        uart_write_bytes(UART_NUM, send_gyr_x_fft_real, strlen(send_gyr_x_fft_real));
        uart_write_bytes(UART_NUM, " ", 1);
        uart_write_bytes(UART_NUM, send_gyr_x_fft_imag, strlen(send_gyr_x_fft_imag));
        uart_write_bytes(UART_NUM, " ", 1);
        uart_write_bytes(UART_NUM, send_gyr_y_fft_real, strlen(send_gyr_y_fft_real));
        uart_write_bytes(UART_NUM, " ", 1);
        uart_write_bytes(UART_NUM, send_gyr_y_fft_imag, strlen(send_gyr_y_fft_imag));
        uart_write_bytes(UART_NUM, " ", 1);
        uart_write_bytes(UART_NUM, send_gyr_z_fft_real, strlen(send_gyr_z_fft_real));
        uart_write_bytes(UART_NUM, " ", 1);
        uart_write_bytes(UART_NUM, send_gyr_z_fft_imag, strlen(send_gyr_z_fft_imag));
        uart_write_bytes(UART_NUM, " ", 1);

        vTaskDelay(pdMS_TO_TICKS(time));
    }

    vTaskDelay(pdMS_TO_TICKS(time+2000));
    // Enviamos los 5 peaks
    printf("Enviando los 5 peaks de los datos\n");
    for (int i=0; i<5; i++) {
        vTaskDelay(pdMS_TO_TICKS(time));
        char send_acc_x_peak[20], send_acc_y_peak[20], send_acc_z_peak[20];
        char send_gyr_x_peak[20], send_gyr_y_peak[20], send_gyr_z_peak[20];
        sprintf(send_acc_x_peak, "%f", data_acc_x[i]);
        sprintf(send_acc_y_peak, "%f", data_acc_y[i]);
        sprintf(send_acc_z_peak, "%f", data_acc_z[i]);
        sprintf(send_gyr_x_peak, "%f", data_gyr_x[i]);
        sprintf(send_gyr_y_peak, "%f", data_gyr_y[i]);
        sprintf(send_gyr_z_peak, "%f", data_gyr_z[i]);
        uart_write_bytes(UART_NUM, send_acc_x_peak, strlen(send_acc_x_peak));
        uart_write_bytes(UART_NUM, " ", 1);
        uart_write_bytes(UART_NUM, send_acc_y_peak, strlen(send_acc_y_peak));
        uart_write_bytes(UART_NUM, " ", 1);
        uart_write_bytes(UART_NUM, send_acc_z_peak, strlen(send_acc_z_peak));
        uart_write_bytes(UART_NUM, " ", 1);
        uart_write_bytes(UART_NUM, send_gyr_x_peak, strlen(send_gyr_x_peak));
        uart_write_bytes(UART_NUM, " ", 1);
        uart_write_bytes(UART_NUM, send_gyr_y_peak, strlen(send_gyr_y_peak));
        uart_write_bytes(UART_NUM, " ", 1);
        uart_write_bytes(UART_NUM, send_gyr_z_peak, strlen(send_gyr_z_peak));
        uart_write_bytes(UART_NUM, " ", 1);
        vTaskDelay(pdMS_TO_TICKS(time));
    }
    vTaskDelay(pdMS_TO_TICKS(time+2000));
}

void bmipowermode(void) {
    // PWR_CTRL: disable auxiliary sensor, gryo and temp; acc on
    // 400Hz en datos acc, filter: performance optimized, acc_range +/-8g (1g = 9.80665 m/s2, alcance max: 78.4532 m/s2, 16 bit= 65536 => 1bit = 78.4532/32768 m/s2)
    uint8_t reg_pwr_ctrl = 0x7D, val_pwr_ctrl = 0x06;
    uint8_t reg_acc_conf = 0x40, val_acc_conf;
    uint8_t reg_pwr_conf = 0x7C, val_pwr_conf = 0x00;

    // 0xA8 100hz, 0xA9 para 200Hz, 0xAA 400hz, 0xAB 800hz, 0xAC 1600hz
    if (Fodr == 200)
        val_acc_conf = 0xA9;
    else if (Fodr == 400)
        val_acc_conf = 0xAA;
    else if (Fodr == 800)
        val_acc_conf = 0xAB;
    else if (Fodr == 1600)
        val_acc_conf = 0xAC;
    else {
        printf("FRECUENCIA DE MUESTREO BMI270 INCORRECTO.\n");
        exit(EXIT_SUCCESS);
    };

    bmi_write(&reg_pwr_ctrl, &val_pwr_ctrl, 1);
    bmi_write(&reg_acc_conf, &val_acc_conf, 1);
    bmi_write(&reg_pwr_conf, &val_pwr_conf, 1);

    vTaskDelay(1000 / portTICK_PERIOD_MS);
}

// Read UART_num for input with timeout of 1 sec
int serial_read(char *buffer, int size){
    int len = uart_read_bytes(UART_NUM, (uint8_t*)buffer, size, pdMS_TO_TICKS(1000));
    return len;
}

void app_main(void) {
    ESP_ERROR_CHECK(bmi_init());
    softreset();
    chipid();
    initialization();
    check_initialization();
    bmipowermode();
    internal_status();
    printf("Comienza lectura\n\n");
    // Esperamos respuesta de la computadora
    //printf("Start program\n\n");
    char dataResponse1[6];
    // char *message = "Data received";
    while (1) {
        int rLen = serial_read(dataResponse1, 6);
        if (rLen > 0) {
            if (strcmp(dataResponse1, "BEGIN") == 0) {
                uart_write_bytes(UART_NUM, "OK\0", 3);
                // printf("%s: %s\n", message, dataResponse1);
                //printf("Iniciando lectura\n");
                // Obtenemos el tamaño de la ventana
                int ventana = get_window_nvs();
                // printf("Ventana obtenida: %d\n", ventana);
                // uart_write_bytes(UART_NUM, (char *)ventana, 6);
                lectura(ventana, 1000);
                uart_write_bytes(UART_NUM, "FINISH\0", 7);
                //printf("Lectura finalizada\n\n");
            }
            else if (strcmp(dataResponse1, "END") == 0) {
                //printf("Reiniciando ESP\n\n");
                uart_write_bytes(UART_NUM, "CLOSED\0", 7);
                restart_ESP();
                //printf("ESP reiniciada\n\n");
                break;
            }
            else {
                //printf("Iniciando cambio de ventana\n");
                // Si caemos aca es porque la computadora quiere que cambiemos el valor de la ventana, valor que fue enviado en forma de string
                int ventana = atoi(dataResponse1);
                //printf("Cambio de ventana a %d\n", ventana);

                // Seteamos la ventana en la nvs
                set_window_nvs(ventana);
                //printf("Ventana seteada\n\n");
            }
        }
    }
}